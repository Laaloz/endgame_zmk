## config/boards/shields/endgame/Kconfig.defconfig
```kconfig
# Shield symbols are declared in Kconfig.shield; this file only sets defaults.

if SHIELD_ENDGAME_LEFT

config ZMK_KEYBOARD_NAME
	default "Endgame Split"

config ZMK_SPLIT_ROLE_CENTRAL
	default y

config ZMK_SPLIT
	default y

endif

if SHIELD_ENDGAME_RIGHT

config ZMK_SPLIT
	default y

endif
```

## config/boards/shields/endgame/Kconfig.shield
```kconfig
# SPDX-License-Identifier: MIT
# Endgame Split — ZMK shield definition

config SHIELD_ENDGAME_LEFT
	def_bool $(shields_list_contains,endgame_left)

config SHIELD_ENDGAME_RIGHT
	def_bool $(shields_list_contains,endgame_right)
```
